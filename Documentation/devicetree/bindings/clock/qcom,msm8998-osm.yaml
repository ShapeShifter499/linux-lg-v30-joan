## Documentation/devicetree/bindings/clock/qcom,msm8998-osm.yaml
```yaml
# SPDX-License-Identifier: (GPL-2.0-only OR BSD-2-Clause)
%YAML 1.2
---
$id: http://devicetree.org/schemas/clock/qcom,msm8998-osm.yaml#
$schema: http://devicetree.org/meta-schemas/core.yaml#

title: Qualcomm MSM8998 Operating State Manager (OSM) CPU clocks

maintainers:
  - Lance <Gero3977@gmail.com>

description: |
  The OSM block of MSM8998 switches the frequency of each CPU cluster by
  walking a lookup table the kernel programs into it.  Unlike the OSM of
  later SoCs, whose table the firmware fills, MSM8998 takes the table from
  the device tree: one row per performance level, five cells per row:

    <frequency-hz freq-data pll-override-data spare-data virtual-corner>

  Clock index 0 is the power (little) cluster, 1 the performance (big)
  cluster.

properties:
  compatible:
    const: qcom,msm8998-osm

  reg:
    items:
      - description: OSM registers
      - description: Power cluster PLL
      - description: Performance cluster PLL

  reg-names:
    items:
      - const: osm
      - const: pwrcl_pll
      - const: perfcl_pll

  interrupts:
    items:
      - description: Power cluster OSM interrupt
      - description: Performance cluster OSM interrupt

  interrupt-names:
    items:
      - const: pwrcl-irq
      - const: perfcl-irq

  clocks:
    items:
      - description: GPLL0, the auxiliary clock source

  clock-names:
    items:
      - const: aux_clk

  '#clock-cells':
    const: 1

  qcom,speedbin:
    $ref: /schemas/types.yaml#/definitions/uint32
    description: Speed bin whose tables to use.  Defaults to 0.

patternProperties:
  '^qcom,(pwr|perf)cl-speedbin[0-9]+-v0$':
    $ref: /schemas/types.yaml#/definitions/uint32-matrix
    description: OSM lookup table of a cluster for one speed bin.
    maxItems: 40
    items:
      items:
        - description: Frequency in Hz
        - description: Frequency data (PLL source, divider, L value)
        - description: PLL override data
        - description: Spare data
        - description: Virtual voltage corner, 1-based

required:
  - compatible
  - reg
  - reg-names
  - clocks
  - clock-names
  - '#clock-cells'
  - qcom,pwrcl-speedbin0-v0
  - qcom,perfcl-speedbin0-v0

additionalProperties: false

examples:
  - |
    #include <dt-bindings/clock/qcom,gcc-msm8998.h>
    #include <dt-bindings/interrupt-controller/arm-gic.h>

    clock-controller@179c0000 {
        compatible = "qcom,msm8998-osm";
        reg = <0x179c0000 0x4000>,
              <0x17916000 0x1000>,
              <0x17816000 0x1000>;
        reg-names = "osm", "pwrcl_pll", "perfcl_pll";
        interrupts = <GIC_SPI 35 IRQ_TYPE_EDGE_RISING>,
                     <GIC_SPI 36 IRQ_TYPE_EDGE_RISING>;
        interrupt-names = "pwrcl-irq", "perfcl-irq";
        #clock-cells = <1>;
        clocks = <&gcc GPLL0>;
        clock-names = "aux_clk";

        qcom,pwrcl-speedbin0-v0 =
            <300000000 0x0004000f 0x01200020 0x1 1>,
            <364800000 0x05040013 0x01200020 0x1 2>;
        qcom,perfcl-speedbin0-v0 =
            <300000000 0x0004000f 0x01200020 0x1 1>,
            <345600000 0x05040012 0x01200020 0x1 2>;
    };
```

## Documentation/devicetree/bindings/display/panel/lg,sw43402.yaml
```yaml
# SPDX-License-Identifier: (GPL-2.0-only OR BSD-2-Clause)
%YAML 1.2
---
$id: http://devicetree.org/schemas/display/panel/lg,sw43402.yaml#
$schema: http://devicetree.org/meta-schemas/core.yaml#

title: LG SW43402 OLED DDIC

maintainers:
  - Lance <Gero3977@gmail.com>

description:
  The SW43402 is a display driver IC for OLED panels, driven over a four
  lane MIPI DSI link in command mode with Display Stream Compression.  The
  LG V30 pairs it with a 6.0 inch 1440x2880 panel.

allOf:
  - $ref: panel-common.yaml#

properties:
  compatible:
    const: lg,sw43402

  reg:
    maxItems: 1

  port: true
  reset-gpios: true

  vddio-supply:
    description: 1.8 V I/O supply

  vpnl-supply:
    description: Panel supply

required:
  - compatible
  - reg
  - port
  - reset-gpios
  - vddio-supply
  - vpnl-supply

additionalProperties: false

examples:
  - |
    #include <dt-bindings/gpio/gpio.h>

    dsi {
        #address-cells = <1>;
        #size-cells = <0>;

        panel@0 {
            compatible = "lg,sw43402";
            reg = <0>;

            vddio-supply = <&vreg_panel_vddio>;
            vpnl-supply = <&vreg_panel_vpnl>;

            reset-gpios = <&tlmm 35 GPIO_ACTIVE_LOW>;

            port {
                endpoint {
                    remote-endpoint = <&mdss_dsi0_out>;
                };
            };
        };
    };
...
```

## Documentation/devicetree/bindings/input/dongwoon,dw7800.yaml
```yaml
# SPDX-License-Identifier: (GPL-2.0-only OR BSD-2-Clause)
%YAML 1.2
---
$id: http://devicetree.org/schemas/input/dongwoon,dw7800.yaml#
$schema: http://devicetree.org/meta-schemas/core.yaml#

title: Dongwoon DW7800 haptic driver

maintainers:
  - Lance <Gero3977@gmail.com>

description:
  The DW7800 drives a linear resonant actuator from 8-bit samples that the
  host streams into its FIFO over I2C.

properties:
  compatible:
    const: dongwoon,dw7800

  reg:
    maxItems: 1

  vdd-supply: true

required:
  - compatible
  - reg

additionalProperties: false

examples:
  - |
    i2c {
        #address-cells = <1>;
        #size-cells = <0>;

        haptics@59 {
            compatible = "dongwoon,dw7800";
            reg = <0x59>;
        };
    };
...
```

## Documentation/devicetree/bindings/interconnect/qcom,msm8998.yaml
```yaml
# SPDX-License-Identifier: (GPL-2.0 OR BSD-2-Clause)
%YAML 1.2
---
$id: http://devicetree.org/schemas/interconnect/qcom,msm8998.yaml#
$schema: http://devicetree.org/meta-schemas/core.yaml#

title: Qualcomm MSM8998 Network-On-Chip interconnect

maintainers:
  - Lance <Gero3977@gmail.com>

description: |
  The Qualcomm MSM8998 interconnect providers support adjusting the
  bandwidth requirements between the various NoC fabrics. QoS
  programming is AP-side for the ap_owned masters; the fabrics' own
  interface clocks are listed per fabric so icc-rpm can enable them
  before touching QoS registers.

properties:
  compatible:
    enum:
      - qcom,msm8998-a1noc
      - qcom,msm8998-a2noc
      - qcom,msm8998-bimc
      - qcom,msm8998-cnoc
      - qcom,msm8998-mnoc
      - qcom,msm8998-snoc

  reg:
    maxItems: 1

  clock-names:
    minItems: 1
    maxItems: 7

  clocks:
    minItems: 1
    maxItems: 7

required:
  - compatible
  - reg

unevaluatedProperties: false

allOf:
  - $ref: qcom,rpm-common.yaml#
  - if:
      properties:
        compatible:
          const: qcom,msm8998-a2noc

    then:
      properties:
        clocks:
          items:
            - description: IPA Clock.
            - description: SDCC2 AHB Clock.
            - description: SDCC4 AHB Clock.
            - description: BLSP1 AHB Clock.

        clock-names:
          items:
            - const: ipa
            - const: sdcc2_ahb
            - const: sdcc4_ahb
            - const: blsp1_ahb

  - if:
      properties:
        compatible:
          const: qcom,msm8998-a1noc

    then:
      properties:
        clocks:
          items:
            - description: UFS AXI Clock.
            - description: Aggregate1 UFS AXI Clock.
            - description: Aggregate1 USB3 AXI Clock.
            - description: BLSP2 AHB Clock.

        clock-names:
          items:
            - const: ufs_axi
            - const: aggre1_ufs_axi
            - const: aggre1_usb3_axi
            - const: blsp2_ahb

  - if:
      properties:
        compatible:
          const: qcom,msm8998-mnoc

    then:
      properties:
        clocks:
          items:
            - description: NoC Configuration AHB Clock.
            - description: MNOC AHB Clock.
            - description: Camera AHB Clock.
            - description: Video AHB Clock.
            - description: Video AXI Clock.
            - description: MDSS AHB Clock.
            - description: MDSS AXI Clock.

        clock-names:
          items:
            - const: noc_cfg_ahb
            - const: mnoc_ahb
            - const: camss_ahb
            - const: video_ahb
            - const: video_axi
            - const: mdss_ahb
            - const: mdss_axi

  - if:
      properties:
        compatible:
          enum:
            - qcom,msm8998-bimc
            - qcom,msm8998-cnoc
            - qcom,msm8998-snoc
    then:
      properties:
        clocks: false
        clock-names: false

examples:
  - |
    #include <dt-bindings/clock/qcom,gcc-msm8998.h>
    #include <dt-bindings/clock/qcom,mmcc-msm8998.h>
    #include <dt-bindings/clock/qcom,rpmcc.h>

    a2noc: interconnect@1700000 {
        compatible = "qcom,msm8998-a2noc";
        reg = <0x01700000 0x10000>;
        #interconnect-cells = <1>;
        clocks = <&rpmcc RPM_SMD_IPA_CLK>,
                 <&gcc GCC_SDCC2_AHB_CLK>,
                 <&gcc GCC_SDCC4_AHB_CLK>,
                 <&gcc GCC_BLSP1_AHB_CLK>;
        clock-names = "ipa",
                      "sdcc2_ahb",
                      "sdcc4_ahb",
                      "blsp1_ahb";
    };
```

## Documentation/devicetree/bindings/media/i2c/hynix,hi553.yaml
```yaml
# SPDX-License-Identifier: (GPL-2.0-only OR BSD-2-Clause)
%YAML 1.2
---
$id: http://devicetree.org/schemas/media/i2c/hynix,hi553.yaml#
$schema: http://devicetree.org/meta-schemas/core.yaml#

title: Hynix HI553 5MP CMOS Image Sensor

maintainers:
  - Lance <Gero3977@gmail.com>

description:
  The Hynix HI553 is a 5 MP CMOS image sensor for mobile phones, with an
  active array of 2560 x 1920 pixels.  It is controlled over I2C and sends
  RAW10 Bayer data over a 2-lane MIPI CSI-2 D-PHY link.  In the LG V30 it
  is the fixed-focus front (VT) camera.

allOf:
  - $ref: /schemas/media/video-interface-devices.yaml#

properties:
  compatible:
    const: hynix,hi553

  reg:
    maxItems: 1

  clocks:
    description: The sensor's external clock (INCK).
    maxItems: 1

  reset-gpios:
    description: The sensor's XCLR reset pin, active low.
    maxItems: 1

  avdd-supply:
    description: Analog supply, 2.8 V.

  dvdd-supply:
    description: Digital core supply.

  dovdd-supply:
    description: Digital I/O supply, 1.8 V.

  port:
    $ref: /schemas/graph.yaml#/$defs/port-base
    additionalProperties: false

    properties:
      endpoint:
        $ref: /schemas/media/video-interfaces.yaml#
        unevaluatedProperties: false

        properties:
          data-lanes:
            items:
              - const: 1
              - const: 2

          link-frequencies: true

        required:
          - data-lanes
          - link-frequencies

required:
  - compatible
  - reg
  - clocks
  - avdd-supply
  - dvdd-supply
  - dovdd-supply
  - port

unevaluatedProperties: false

examples:
  - |
    #include <dt-bindings/gpio/gpio.h>

    i2c {
        #address-cells = <1>;
        #size-cells = <0>;

        camera@28 {
            compatible = "hynix,hi553";
            reg = <0x28>;

            clocks = <&mmcc_mclk2>;
            assigned-clocks = <&mmcc_mclk2>;
            assigned-clock-rates = <24000000>;

            reset-gpios = <&tlmm 9 GPIO_ACTIVE_LOW>;

            avdd-supply = <&cam_vana_2p8>;
            dvdd-supply = <&cam1_dvdd_1p05>;
            dovdd-supply = <&cam_vio_1p8>;

            orientation = <0>;
            rotation = <90>;

            port {
                endpoint {
                    data-lanes = <1 2>;
                    link-frequencies = /bits/ 64 <440000000>;
                    remote-endpoint = <&csiphy2_ep>;
                };
            };
        };
    };
...
```

## Documentation/devicetree/bindings/media/i2c/rohm,bu24235.yaml
```yaml
# SPDX-License-Identifier: (GPL-2.0-only OR BSD-2-Clause)
%YAML 1.2
---
$id: http://devicetree.org/schemas/media/i2c/rohm,bu24235.yaml#
$schema: http://devicetree.org/meta-schemas/core.yaml#

title: ROHM BU24235 AF/OIS lens controller

maintainers:
  - Lance <Gero3977@gmail.com>

description: >-
  The BU24235 is a closed-loop AF/OIS lens controller with RAM firmware
  download, used in the LG Innotek rear camera module of the LG V30
  (joan).  It sits on the camera module's CCI I2C bus next to the IMX351
  sensor and the module EEPROM. Its VAF rail and active-low reset must be
  enabled in addition to the shared module supplies before it answers on
  the bus. The module is dual-sourced: the EEPROM map version at 0x0be2
  tells the BU24235 and the Renesas controller variant apart, and this
  driver declines the bus when the Renesas one is fitted.

  The firmware files are LG's per-revision controller programs, selected
  by the EEPROM calibration version at 0x0ac2.

allOf:
  - $ref: /schemas/media/video-interface-devices.yaml#

properties:
  compatible:
    const: rohm,bu24235

  reg:
    maxItems: 1

  vaf-supply:
    description: Power supply for the AF/OIS controller.

  reset-gpios:
    maxItems: 1
    description:
      Active-low reset for the AF/OIS controller. A high level releases the
      controller from reset.

required:
  - compatible
  - reg
  - vaf-supply
  - reset-gpios

additionalProperties: false

examples:
  - |
    #include <dt-bindings/gpio/gpio.h>

    i2c {
        #address-cells = <1>;
        #size-cells = <0>;

        lens@3e {
            compatible = "rohm,bu24235";
            reg = <0x3e>;
            vaf-supply = <&cam0_vaf>;
            reset-gpios = <&tlmm 23 GPIO_ACTIVE_LOW>;
        };
    };

...
```
