## Documentation/devicetree/bindings/media/i2c/sony,imx351.yaml
```yaml
# SPDX-License-Identifier: (GPL-2.0-only OR BSD-2-Clause)
%YAML 1.2
---
$id: http://devicetree.org/schemas/media/i2c/sony,imx351.yaml#
$schema: http://devicetree.org/meta-schemas/core.yaml#

title: Sony IMX351 16MP CMOS Image Sensor

maintainers:
  - Lance <Gero3977@gmail.com>

description:
  The Sony IMX351 is a 16MP stacked CMOS image sensor for mobile phones,
  with an active array of 4656 x 3496 pixels.  It is controlled over I2C and
  sends RAW10 Bayer data over a 4-lane MIPI CSI-2 D-PHY link.

allOf:
  - $ref: /schemas/media/video-interface-devices.yaml#

properties:
  compatible:
    const: sony,imx351

  reg:
    enum:
      - 0x10
      - 0x1a

  clocks:
    description: The sensor's external clock (INCK).
    maxItems: 1

  reset-gpios:
    description: The sensor's XCLR reset pin, active low.
    maxItems: 1

  avdd-supply:
    description: Analog supply, 2.8 V.

  dvdd-supply:
    description: Digital core supply.

  dovdd-supply:
    description: Digital I/O supply, 1.8 V.

  flash-leds: true
  lens-focus: true

  port:
    $ref: /schemas/graph.yaml#/$defs/port-base
    additionalProperties: false

    properties:
      endpoint:
        $ref: /schemas/media/video-interfaces.yaml#
        unevaluatedProperties: false

        properties:
          data-lanes:
            items:
              - const: 1
              - const: 2
              - const: 3
              - const: 4

          link-frequencies: true

        required:
          - data-lanes
          - link-frequencies

required:
  - compatible
  - reg
  - clocks
  - avdd-supply
  - dvdd-supply
  - dovdd-supply
  - port

unevaluatedProperties: false

examples:
  - |
    #include <dt-bindings/gpio/gpio.h>

    i2c {
        #address-cells = <1>;
        #size-cells = <0>;

        camera@1a {
            compatible = "sony,imx351";
            reg = <0x1a>;

            clocks = <&mmcc_mclk0>;
            assigned-clocks = <&mmcc_mclk0>;
            assigned-clock-rates = <24000000>;

            reset-gpios = <&tlmm 30 GPIO_ACTIVE_LOW>;

            avdd-supply = <&cam0_avdd_2p8>;
            dvdd-supply = <&cam0_dvdd>;
            dovdd-supply = <&vreg_lvs1a_1p8>;

            orientation = <1>;
            rotation = <90>;

            port {
                endpoint {
                    data-lanes = <1 2 3 4>;
                    link-frequencies = /bits/ 64 <600000000>;
                    remote-endpoint = <&csiphy0_ep>;
                };
            };
        };
    };
...
```

## Documentation/devicetree/bindings/phy/qcom,msm8998-qmp-usb3-dp-phy.yaml
```yaml
# SPDX-License-Identifier: (GPL-2.0 OR BSD-2-Clause)
%YAML 1.2
---
$id: http://devicetree.org/schemas/phy/qcom,msm8998-qmp-usb3-dp-phy.yaml#
$schema: http://devicetree.org/meta-schemas/core.yaml#

title: Qualcomm QMP USB3-DP PHY controller (MSM8998)

maintainers:
  - Vinod Koul <vkoul@kernel.org>

description:
  The QMP PHY controller supports physical layer functionality for USB3 or
  DisplayPort over USB-C. USB3 and DisplayPort are exclusive. This is not the
  USB-only PHY used by other MSM8998 boards.

properties:
  compatible:
    const: qcom,msm8998-qmp-usb3-dp-phy

  reg:
    maxItems: 1

  clocks:
    maxItems: 4

  clock-names:
    items:
      - const: aux
      - const: ref
      - const: cfg_ahb
      - const: pipe

  resets:
    maxItems: 3

  reset-names:
    items:
      - const: phy
      - const: phy_phy
      - const: dp_phy

  vdda-phy-supply: true

  vdda-pll-supply: true

  "#clock-cells":
    const: 1
    description:
      See include/dt-bindings/phy/phy-qcom-qmp.h. A missing cell selects the
      USB3 pipe clock, so an existing USB consumer does not need rewriting.

  "#phy-cells":
    const: 1
    description:
      See include/dt-bindings/phy/phy-qcom-qmp.h. A missing cell selects the
      USB3 PHY, so an existing dwc3 consumer does not need rewriting.

  mode-switch: true
  orientation-switch: true

  qcom,tcsr-reg:
    $ref: /schemas/types.yaml#/definitions/phandle-array
    items:
      - items:
          - description: phandle to TCSR hardware block
          - description: offset of the VLS CLAMP register
          - description: offset of the PHY mode register
    description: Clamp and PHY mode register present in the TCSR

  ports:
    $ref: /schemas/graph.yaml#/properties/ports
    properties:
      port@0:
        $ref: /schemas/graph.yaml#/properties/port
        description: Output endpoint of the PHY

      port@1:
        $ref: /schemas/graph.yaml#/properties/port
        description: Incoming endpoint from the USB controller

required:
  - compatible
  - reg
  - clocks
  - clock-names
  - resets
  - reset-names
  - vdda-phy-supply
  - vdda-pll-supply
  - "#clock-cells"
  - "#phy-cells"
  - qcom,tcsr-reg

additionalProperties: false

examples:
  - |
    #include <dt-bindings/clock/qcom,gcc-msm8998.h>
    #include <dt-bindings/clock/qcom,rpmh.h>

    phy@c010000 {
      compatible = "qcom,msm8998-qmp-usb3-dp-phy";
      reg = <0x0c010000 0x2000>;

      clocks = <&gcc GCC_USB3_PHY_AUX_CLK>,
               <&gcc GCC_USB3_CLKREF_CLK>,
               <&gcc GCC_USB_PHY_CFG_AHB2PHY_CLK>,
               <&gcc GCC_USB3_PHY_PIPE_CLK>;
      clock-names = "aux",
                    "ref",
                    "cfg_ahb",
                    "pipe";
      #clock-cells = <1>;
      #phy-cells = <1>;

      resets = <&gcc GCC_USB3_PHY_BCR>,
               <&gcc GCC_USB3PHY_PHY_BCR>,
               <&gcc GCC_USB3_DP_PHY_BCR>;
      reset-names = "phy",
                    "phy_phy",
                    "dp_phy";

      vdda-phy-supply = <&vreg_l1a_0p875>;
      vdda-pll-supply = <&vreg_l2a_1p2>;

      mode-switch;
      orientation-switch;

      qcom,tcsr-reg = <&tcsr_regs_2 0xb244 0xb248>;
    };
```

## Documentation/devicetree/bindings/sound/ess,es9218p.yaml
```yaml
# SPDX-License-Identifier: (GPL-2.0-only OR BSD-2-Clause)
%YAML 1.2
---
$id: http://devicetree.org/schemas/sound/ess,es9218p.yaml#
$schema: http://devicetree.org/meta-schemas/core.yaml#

title: ESS Technology ES9218P headphone DAC and amplifier

maintainers:
  - Lance <Gero3977@gmail.com>

description:
  The ES9218P is a stereo DAC with an integrated headphone amplifier,
  controlled over I2C and fed over I2S.  Its RESET_N and MODE2 pins together
  select the operating mode (HiFi, LowFi, low power bypass or standby); in
  low power bypass the part passes an external analog signal through to the
  headphone output.

allOf:
  - $ref: dai-common.yaml#

properties:
  compatible:
    const: ess,es9218p

  reg:
    maxItems: 1

  power-gpios:
    maxItems: 1
    description: Enables the supply rails of the part.

  reset-gpios:
    maxItems: 1
    description: The RESET_N pin.

  hph-sw-gpios:
    maxItems: 1
    description:
      The MODE2 pin.  Together with RESET_N it selects the operating mode.

  ess,internal-ldo:
    type: boolean
    description:
      The part runs its digital core from its internal LDO rather than from
      an external 1.0 V supply.

  "#sound-dai-cells":
    const: 0

required:
  - compatible
  - reg
  - "#sound-dai-cells"

unevaluatedProperties: false

examples:
  - |
    #include <dt-bindings/gpio/gpio.h>

    i2c {
        #address-cells = <1>;
        #size-cells = <0>;

        headphone-dac@48 {
            compatible = "ess,es9218p";
            reg = <0x48>;
            power-gpios = <&pm8998_gpios 10 GPIO_ACTIVE_HIGH>;
            reset-gpios = <&pmi8998_gpios 2 GPIO_ACTIVE_LOW>;
            hph-sw-gpios = <&pm8998_gpios 12 GPIO_ACTIVE_HIGH>;
            ess,internal-ldo;
            #sound-dai-cells = <0>;
        };
    };
```

## Documentation/devicetree/bindings/sound/qcom,q6voice.yaml
```yaml
# SPDX-License-Identifier: GPL-2.0 OR BSD-2-Clause
%YAML 1.2
---
$id: http://devicetree.org/schemas/sound/qcom,q6voice.yaml#
$schema: http://devicetree.org/meta-schemas/core.yaml#

title: Qualcomm ADSP Core Voice services (MVM, CVS, CVP)

maintainers:
  - Lance <Gero3977@gmail.com>

description:
  The Core Voice Driver services of the ADSP carry circuit-switched and VoLTE
  calls.  The Multimode Voice Manager (MVM) owns a voice session, the Core
  Voice Stream (CVS) runs the vocoder, and the Core Voice Processor (CVP)
  applies the voice topology and connects the session to AFE ports.

allOf:
  - $ref: /schemas/soc/qcom/qcom,apr-services.yaml#

properties:
  compatible:
    enum:
      - qcom,q6mvm
      - qcom,q6cvs
      - qcom,q6cvp

required:
  - compatible

unevaluatedProperties: false

examples:
  - |
    #include <dt-bindings/soc/qcom,apr.h>

    apr {
        #address-cells = <1>;
        #size-cells = <0>;

        service@9 {
            compatible = "qcom,q6mvm";
            reg = <APR_SVC_ADSP_MVM>;
        };

        service@a {
            compatible = "qcom,q6cvs";
            reg = <APR_SVC_ADSP_CVS>;
        };

        service@b {
            compatible = "qcom,q6cvp";
            reg = <APR_SVC_ADSP_CVP>;
        };
    };
```

## Documentation/devicetree/bindings/sound/qcom,wcn3990-btfm.yaml
```yaml
# SPDX-License-Identifier: (GPL-2.0-only OR BSD-2-Clause)
%YAML 1.2
---
$id: http://devicetree.org/schemas/sound/qcom,wcn3990-btfm.yaml#
$schema: http://devicetree.org/meta-schemas/core.yaml#

title: Qualcomm WCN399x Bluetooth/FM SLIMbus audio

maintainers:
  - Lance <Gero3977@gmail.com>

description: |
  The Qualcomm WCN399x Bluetooth combination chip exposes a SLIMbus
  ported generic device (device index 1) holding the FM receiver and
  SCO audio slave ports, plus its interface device (device index 0)
  carrying the port configuration registers.  The FM receiver streams
  digitised analogue baseband at 48 kHz over a two-channel group on the
  second msm8998 SLIMbus engine, which the ADSP receives on its
  SLIMBUS_8_TX AFE port.  Ported from the Qualcomm/LG downstream
  btfm_slim drivers.

properties:
  compatible:
    const: slim217,220

  reg:
    maxItems: 1

  slim-ifc-dev:
    description: Phandle to the interface device (device index 0)
    $ref: /schemas/types.yaml#/definitions/phandle

  "#sound-dai-cells":
    const: 1

required:
  - compatible
  - reg

allOf:
  - if:
      required:
        - slim-ifc-dev
    then:
      required:
        - "#sound-dai-cells"

additionalProperties: true

examples:
  - |
    slim@3 {
        reg = <3>;
        #address-cells = <2>;
        #size-cells = <0>;

        codec@1,0 {
            compatible = "slim217,220";
            reg = <1 0>;
            slim-ifc-dev = <&wcn3990_ifd>;
            #sound-dai-cells = <1>;
        };
    };
```
